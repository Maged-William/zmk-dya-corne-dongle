## config/boards/shields/dabase_v02/Kconfig.defconfig
```kconfig
if SHIELD_DABASE_V02_CENTRAL_DONGLE

config ZMK_KEYBOARD_NAME
    default "DabaseV0-2"

config ZMK_SPLIT_ROLE_CENTRAL
    default y

config ZMK_USB
    default y

config ZMK_SPLIT_BLE_CENTRAL_PERIPHERALS
    default 2

config BT_MAX_CONN
    default 7

config BT_MAX_PAIRED
    default 7

endif

if SHIELD_DABASE_V02_CENTRAL_DONGLE || SHIELD_DABASE_V02_LEFT || SHIELD_DABASE_V02_RIGHT

config ZMK_SPLIT
    default y

config ZMK_BLE
    default y

endif
```

## config/boards/shields/dabase_v02/Kconfig.shield
```kconfig
config SHIELD_DABASE_V02_LEFT
    def_bool $(shields_list_contains,dabase_v02_left)

config SHIELD_DABASE_V02_RIGHT
    def_bool $(shields_list_contains,dabase_v02_right)

config SHIELD_DABASE_V02_CENTRAL_DONGLE
    def_bool $(shields_list_contains,dabase_v02_central_dongle)
```
