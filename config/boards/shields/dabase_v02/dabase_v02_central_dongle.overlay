// dabase_v02_central_dongle.overlay

#include "dabase_v02.dtsi"
#include <behaviors/battery_history_request.dtsi>
#include <input/processors.dtsi>
#include <input/processors/runtime-input-processor.dtsi>

/ {
    // Completely wipe out the encoder and sensor definitions for the dongle
    /delete-node/ encoder_left;
    /delete-node/ sensors;
};

&kscan0 {
    compatible = "zmk,kscan-mock";
    /delete-property/ wakeup-source;
    columns = <0>;
    rows = <0>;
    events = <>;
};
